#include "include/trackpoint-PS2.dtsi"
#include <zephyr/dt-bindings/input/input-event-codes.h>
#include <dt-bindings/zmk/mouse.h>

/ {
    trackpoint_listener {
        compatible = "zmk,input-listener";
        device = <&trackpoint>;
    };
};
