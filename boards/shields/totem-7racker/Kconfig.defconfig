## boards/shields/totem-7racker/Kconfig.defconfig
```kconfig
if SHIELD_TOTEM_7RACKER_LEFT
config ZMK_KEYBOARD_NAME
    default "Totem 7racker"

config ZMK_SPLIT_ROLE_CENTRAL
    default y
endif

if SHIELD_TOTEM_7RACKER_LEFT || SHIELD_TOTEM_7RACKER_RIGHT
config ZMK_SPLIT
    default y

config SPI
    default y
endif
```

## boards/shields/totem-7racker/Kconfig.shield
```kconfig
config SHIELD_TOTEM_7RACKER_LEFT
    def_bool $(shields_list_contains,totem-7racker_left)
    select SPI

config SHIELD_TOTEM_7RACKER_RIGHT
    def_bool $(shields_list_contains,totem-7racker_right)
    select SPI

config SHIELD_TOTEM_7RACKER_TRACKPOINT
    def_bool $(shields_list_contains,totem-7racker_trackpoint)
```

## config/west.yml
```yaml
manifest:
  remotes:
    - name: zmkfirmware
      url-base: https://github.com/zmkfirmware
    - name: badjeff
      url-base: https://github.com/badjeff
    - name: petejohanson
      url-base: https://github.com/petejohanson
  projects:
    - name: zmk
      remote: petejohanson
      revision: feat/pointers-with-input-processors
      import: app/west.yml
    - name: kb_zmk_ps2_mouse_trackpoint_driver
      remote: badjeff
      revision: main
  self:
    path: config
```
